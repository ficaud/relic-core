## Kconfig
```kconfig
# Copyright 2025 NXP
# SPDX-License-Identifier: GPL-3.0-or-later

mainmenu "Network Wi-Fi relic-core application"

config WIFI_SAMPLE_AP_SSID
	string "SSID of soft AP"
	help
	  SSID of the soft AP created by the sample.
	  Fox example: "SOFT-AP"

config WIFI_SAMPLE_SSID
	string "SSID of the target AP"
	help
	  SSID of the access point to connect to in station mode.
	  For example: "TARGET-AP"

config WIFI_SAMPLE_PSK
	string "Pre-shared key for target AP"
	help
	  WPA2 password used to connect to the target AP.
	  For example: "PSK"

config WIFI_SAMPLE_DHCPV4_START
	bool "Start DHCPv4 server in application layer."
	default y
	help
	  Enable this option to start the DHCPv4 server from the application layer,
	  typically before the Soft AP is initialized.

	  When disabled, the DHCPv4 server startup timing is determined by the vendor's
	  implementation. In some cases, the server may be started after the AP is up,
	  using the vendor's default IP address, gateway, subnet mask.


config RELIC_QR_DECODE_MAX_DIM
	int "Maximum QR decode image dimension (px)"
	default 224
	help
	  Maximum width/height (in pixels) of the grayscale image accepted by the
	  on-device QR decoder. The ESP32-S3 decodes up to 224x224 in its internal
	  RAM (or 640x640 when PSRAM is enabled), while the classic ESP32 (DevKit
	  V1) is limited to 192x192 to stay within its smaller RAM budget.

	  The value is baked into the embedded web page (embed-assets.py replaces
	  __QR_MAX_DIM__) so the client downsizes the captured image accordingly.

config RELIC_QR_DECODE_SERVER
	bool "Decode QR codes on the device"
	default n
	help
	  When enabled, the firmware embeds a QR decoder and serves a
	  POST /qr_decode endpoint: the web page uploads the grayscale image and
	  the ESP32 decodes the QR code.

	  This is opt-in per board: the classic ESP32 (DevKit V1) does not have
	  enough RAM for a decoder on top of the Wi-Fi stack, so it stays disabled
	  and the web page falls back to local (jsQR) decoding. Only boards with
	  enough RAM (ESP32-S3, ~400 KB app RAM) enable it in their board fragment.

choice RELIC_QR_DECODE_BACKEND
	prompt "QR decode backend"
	default RELIC_QR_DECODE_BACKEND_QUIRC
	depends on RELIC_QR_DECODE_SERVER
	help
	  Select the QR decoding library used by the on-device decoder. quirc is
	  the historical backend; ZXing-cpp (QR-only build) is more robust under
	  uneven lighting and perspective, at the cost of a C++ runtime.

config RELIC_QR_DECODE_BACKEND_QUIRC
	bool "quirc"

config RELIC_QR_DECODE_BACKEND_ZXING
	bool "ZXing-cpp (QR-only)"

endchoice

config RELIC_QR_DECODE_PSRAM
	bool "Allocate QR decode buffers in external PSRAM"
	default n
	depends on RELIC_QR_DECODE_SERVER
	help
	  Route the decoder's input buffer and C++ heap allocations to external
	  PSRAM via Zephyr's shared multi-heap, so images larger than the internal
	  ~66 KB libc heap can be decoded (e.g. 640x640 on the XIAO ESP32S3).

	  Requires CONFIG_ESP_SPIRAM=y (and CONFIG_SPIRAM_MODE_OCT=y for octal
	  PSRAM parts such as the ESP32-S3R8 used on the XIAO ESP32S3).

if WIFI_SAMPLE_DHCPV4_START

# Some vendors start the DHCPv4 server after Soft AP initialization,
# using default IP address and subnet mask. In such cases, manual
# configuration of gateway and netmask may not be necessary.
# The following options are used only if the DHCPv4 server is started
# by the application.

config WIFI_SAMPLE_AP_IP_ADDRESS
	string "IP address of soft AP"
	help
	  IP address assigned to the soft AP interface.
	  For example: "192.168.4.1"

config WIFI_SAMPLE_AP_NETMASK
	string "Netmask of soft AP"
	help
	  Subnet mask for the soft AP interface.
	  For example: "255.255.255.0"
endif # WIFI_SAMPLE_DHCPV4_START

source "Kconfig.zephyr"
```
